## sdkconfig.defaults
```kconfig
# partitions
CONFIG_PARTITION_TABLE_CUSTOM=y
CONFIG_PARTITION_TABLE_CUSTOM_FILENAME="partitions.csv"
CONFIG_PARTITION_TABLE_FILENAME="partitions.csv"
CONFIG_PARTITION_TABLE_OFFSET=0x11000
CONFIG_PARTITION_TABLE_MD5=y

# cpu & optimizations
CONFIG_ESP32_REV_MIN=3
CONFIG_FREERTOS_HZ=1000
CONFIG_COMPILER_OPTIMIZATION_PERF=y
CONFIG_OPTIMIZATION_ASSERTIONS_SILENT=y
CONFIG_ESP32_DEFAULT_CPU_FREQ_240=y

# flash
ESPTOOLPY_FLASHMODE_QIO=y
ESPTOOLPY_FLASHFREQ_80M=y
CONFIG_ESPTOOLPY_FLASHMODE_QIO=y
CONFIG_ESPTOOLPY_FLASHFREQ_80M=y
CONFIG_ESPTOOLPY_FLASHSIZE_4MB=y
CONFIG_ESPTOOLPY_FLASHSIZE="4MB"
CONFIG_SPI_FLASH_ENABLE_ENCRYPTED_READ_WRITE=n

# stack sizes
CONFIG_MAIN_TASK_STACK_SIZE=65536
CONFIG_ESP_MAIN_TASK_STACK_SIZE=65536
CONFIG_ESP_MINIMAL_SHARED_STACK_SIZE=8192
CONFIG_ARDUINO_LOOP_STACK_SIZE=8192

# networking
CONFIG_ETH_ENABLED=n
CONFIG_ESP32_WIFI_ENABLED=y
CONFIG_ESP_TLS_USING_MBEDTLS=y
CONFIG_ESP_TLS_PSK_VERIFICATION=y


CONFIG_ESP_MAIN_TASK_AFFINITY_CPU1=y
CONFIG_INT_WDT=n
CONFIG_ESP_TASK_WDT=y
CONFIG_TASK_WDT_TIMEOUT_S=5
CONFIG_TASK_WDT_CHECK_IDLE_TASK_CPU0=y
CONFIG_TASK_WDT_CHECK_IDLE_TASK_CPU1=y

CONFIG_ESP32_BROWNOUT_DET=y
CONFIG_ESP32_BROWNOUT_DET_LVL_SEL_7=y
CONFIG_BROWNOUT_DET_LVL=7
CONFIG_ESP32_BROWNOUT_DET_LVL=7

# logging
CONFIG_BOOTLOADER_LOG_LEVEL_WARN=y
CONFIG_BOOTLOADER_LOG_LEVEL=2
CONFIG_LOG_DEFAULT_LEVEL_DEBUG=y
CONFIG_LOG_DEFAULT_LEVEL=4
CONFIG_LOG_MAXIMUM_EQUALS_DEFAULT=n
CONFIG_LOG_MAXIMUM_LEVEL=4
CONFIG_LOG_COLORS=y
CONFIG_LOG_TIMESTAMP_SOURCE_RTOS=y
```
